## conf/distro/walky.conf
```bitbake
require conf/distro/poky.conf

DISTRO = "walky"
DISTRO_NAME = "Walky"
DISTRO_VERSION = "0.1"

# systemd à la place de SysVinit
DISTRO_FEATURES:append = " systemd"
DISTRO_FEATURES:append = " pam"
DISTRO_FEATURES:append = " usrmerge"
DISTRO_FEATURES:append = " wayland"

VIRTUAL-RUNTIME_init_manager = "systemd"
VIRTUAL-RUNTIME_initscripts = "systemd-compat-units"
VIRTUAL-RUNTIME_login_manager = "shadow-base"
```
